/dts-v1/;
/plugin/;

/ {
    compatible = "brcm,bcm2711";

    fragment@0 {
        target = <&i2c1>;
        __overlay__ {
            #address-cells = <1>;
            #size-cells = <0>;

            mpu6050@68 {
                compatible = "arun,mpu6050";
                reg = <0x68>;
            };
        };
    };
};

